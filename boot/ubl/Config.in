## boot/ubl/Config.in
```kconfig
config BR2_TARGET_UBL
	bool "ubl"
	help
	  Build the UBL bootloader

if BR2_TARGET_UBL
config BR2_TARGET_UBL_CONFIGNAME
	string "UBL configuration name"
	help
	  Specify the UBL configuration to be built.

endif # BR2_TARGET_UBL
```

## configs/leopardboard_dm368_defconfig
```kconfig
BR2_arm=y
BR2_arm926t=y
BR2_JLEVEL=6
BR2_TOOLCHAIN_EXTERNAL=y
BR2_ENABLE_LOCALE_PURGE=y
BR2_ENABLE_LOCALE_WHITELIST="C"
BR2_ROOTFS_DEVICE_CREATION_DYNAMIC_DEVTMPFS=y
# BR2_TARGET_GENERIC_REMOUNT_ROOTFS_RW is not set
BR2_ROOTFS_POST_BUILD_SCRIPT="board/leopardboard/dm368/post-build.sh"
BR2_PACKAGE_BUSYBOX_CONFIG="board/leopardboard/dm368/busybox_defconfig"
BR2_PACKAGE_BUSYBOX_SHOW_OTHERS=y
BR2_PACKAGE_TI_CODEC_ENGINE=y
BR2_PACKAGE_TI_DM365_CODECS_H264ENC=y
BR2_PACKAGE_LZOP=y
BR2_PACKAGE_PV=y
BR2_PACKAGE_QT=y
BR2_PACKAGE_QT_LICENSE_APPROVED=y
# BR2_PACKAGE_QT_PIXEL_DEPTH_8 is not set
# BR2_PACKAGE_QT_PIXEL_DEPTH_16 is not set
# BR2_PACKAGE_QT_XML is not set
# BR2_PACKAGE_QT_SCRIPT is not set
BR2_PACKAGE_DUMPDM365=y
BR2_PACKAGE_E2FSPROGS=y
# BR2_PACKAGE_E2FSPROGS_BADBLOCKS is not set
# BR2_PACKAGE_E2FSPROGS_CHATTR is not set
# BR2_PACKAGE_E2FSPROGS_DUMPE2FS is not set
# BR2_PACKAGE_E2FSPROGS_E2FREEFRAG is not set
# BR2_PACKAGE_E2FSPROGS_E2FSCK is not set
# BR2_PACKAGE_E2FSPROGS_E2LABEL is not set
# BR2_PACKAGE_E2FSPROGS_E2UNDO is not set
# BR2_PACKAGE_E2FSPROGS_FILEFRAG is not set
# BR2_PACKAGE_E2FSPROGS_FINDFS is not set
# BR2_PACKAGE_E2FSPROGS_FSCK is not set
# BR2_PACKAGE_E2FSPROGS_LOGSAVE is not set
# BR2_PACKAGE_E2FSPROGS_LSATTR is not set
# BR2_PACKAGE_E2FSPROGS_MKLOSTFOUND is not set
# BR2_PACKAGE_E2FSPROGS_TUNE2FS is not set
# BR2_PACKAGE_E2FSPROGS_UUIDGEN is not set
BR2_PACKAGE_I2C_TOOLS=y
BR2_PACKAGE_DROPBEAR=y
BR2_PACKAGE_DROPBEAR_DISABLE_REVERSEDNS=y
BR2_PACKAGE_HOST_DM36X_PACKAGER=y
BR2_TARGET_ROOTFS_EXT2=y
# BR2_TARGET_ROOTFS_TAR is not set
BR2_TARGET_UBL=y
BR2_TARGET_UBL_CONFIGNAME="dm365sdmmc"
BR2_TARGET_UBOOT=y
BR2_TARGET_UBOOT_BOARDNAME="davinci_dm365evm"
BR2_TARGET_UBOOT_CUSTOM_GIT=y
BR2_TARGET_UBOOT_CUSTOM_GIT_REPO_URL="git@bitbucket.org:fhunleth/dm36x-uboot.git"
BR2_TARGET_UBOOT_CUSTOM_GIT_VERSION="5e86541"
BR2_LINUX_KERNEL=y
BR2_LINUX_KERNEL_CUSTOM_GIT=y
BR2_LINUX_KERNEL_CUSTOM_GIT_REPO_URL="git@bitbucket.org:fhunleth/dm36x-kernel.git"
BR2_LINUX_KERNEL_CUSTOM_GIT_VERSION="5e68412"
BR2_LINUX_KERNEL_DEFCONFIG="leopardboard"
BR2_LINUX_KERNEL_INSTALL_TARGET=y
```

## package/dm36x-packager/Config.in.host
```kconfig
config BR2_PACKAGE_HOST_DM36X_PACKAGER
	bool "host dm36x-packager"
	help
	  Packager utility for creating SD Card images for the DM36x
```

## package/dumpdm365/Config.in
```kconfig
config BR2_PACKAGE_DUMPDM365
	bool "dumpdm365"
	help
	  Utility for dumping DM365 registers

	  https://github.com/fhunleth/dumpdm365
```

## package/libqxt/Config.in
```kconfig
config BR2_PACKAGE_LIBQXT
	depends on BR2_PACKAGE_QT
	bool "libqxt"
	help
	  Qxt is an extension library for Qt providing a suite of
	  cross-platform utility classes to add functionality not
	  readily available in the Qt toolkit by Qt Development
	  Frameworks, Nokia.

if BR2_PACKAGE_LIBQXT

choice
        prompt "Library type"
        help
          Selects the library type: Shared or Static

config BR2_PACKAGE_LIBQXT_SHARED
        bool "Shared library"
        depends on !BR2_PREFER_STATIC_LIB
        help
          Create and use shared Qt libraries.
          If you have multiple programs that depend on Qxt, say Y.

config BR2_PACKAGE_LIBQXT_STATIC
        bool "Static Library"
        help
          Create and use static Qxt libraries.
          If you don't have multiple programs on the target that depends on
          Qxt, then this will save you quite some of storage space.
          If unsure, say Y.

endchoice

config BR2_PACKAGE_LIBQXT_BERKELEYDB_MODULE
	bool "BerkeleyDB Module"
	depends on BR2_PACKAGE_BERKELEYDB
	help
	  Compile in the BerkeleyBD module.

config BR2_PACKAGE_LIBQXT_GUI_MODULE
        bool "Gui Module"
	depends on BR2_PACKAGE_QT_GUI_MODULE
        default y
        help
          Compiles in the Qxt widgets.

config BR2_PACKAGE_LIBQXT_NETWORK_MODULE
	bool "Network Module"
	depends on BR2_PACKAGE_QT_NETWORK
	default y
	help
	  Compile in the Qxt networking extensions.

config BR2_PACKAGE_LIBQXT_SQL_MODULE
	bool "SQL Module"
	depends on BR2_PACKAGE_SQLITE
	default y
	help
	  Compile in the Qxt Sqlite module.

config BR2_PACKAGE_LIBQXT_WEB_MODULE
	bool "Web Module"
	select BR2_PACKAGE_LIBQXT_NETWORK_MODULE
	help
	  Compile in the Qxt web module.

config BR2_PACKAGE_LIBQXT_ZEROCONF_MODULE
	bool "Zeroconf Module"
	select BR2_PACKAGE_LIBQXT_NETWORK_MODULE
	help
	  Compile in the Qxt zeroconf module.

endif
```

## package/meteorcam-web/Config.in
```kconfig
config BR2_PACKAGE_METEORCAM_WEB
	bool "meteorcam-web"
	select BR2_PACKAGE_LIGHTTPD
	help
	  This project contains the web interface for
	  the MeteorCam.
```

## package/qt-mobility/Config.in
```kconfig
menuconfig BR2_PACKAGE_QT_MOBILITY
	bool "qt-mobility"
	depends on BR2_PACKAGE_QT
	help
	  Qt Mobility enables Qt developers to include standard mobile
	  functionality in their applications.

	  http://qt.gitorious.org/qt-mobility

if BR2_PACKAGE_QT_MOBILITY

config BR2_PACKAGE_QT_MOBILITY_DEBUG
	bool "Compile with debug support"
	help
	  If unsure, say N.

config BR2_PACKAGE_QT_MOBILITY_DEMOS
	bool "Compile and install demos and examples (with code)"
	select BR2_PACKAGE_QT_GUI_MODULE
	help
	  If unsure, say N.

config BR2_PACKAGE_QT_MOBILITY_BEARER
	bool "Bearer Module"
	help
	  Build the Qt Mobility Bearer module.

config BR2_PACKAGE_QT_MOBILITY_CONTACTS
	bool "Contacts Module"
	help
	  Build the Qt Mobility Contacts module.

config BR2_PACKAGE_QT_MOBILITY_GALLERY
	bool "Gallery Module"
	help
	  Build the Qt Mobility Gallery module.

config BR2_PACKAGE_QT_MOBILITY_LOCATION
	bool "Location Module"
	help
	  Build the Qt Mobility Location module.

config BR2_PACKAGE_QT_MOBILITY_PUBLISHSUBSCRIBE
	bool "Publish Subscribe Module"
	help
	  Build the Qt Mobility Publish Subscribe module.

config BR2_PACKAGE_QT_MOBILITY_MESSAGING
	bool "Messaging Module"
	help
	  Build the Qt Mobility Messaging module.

config BR2_PACKAGE_QT_MOBILITY_MULTIMEDIA
	bool "Multimedia Module"
	help
	  Build the Qt Mobility Multimedia module.

config BR2_PACKAGE_QT_MOBILITY_SYSTEMINFO
	bool "Systeminfo Module"
	help
	  Build the Qt Mobility Systeminfo module.

config BR2_PACKAGE_QT_MOBILITY_SERVICEFRAMEWORK
	bool "Service Framework Module"
	help
	  Build the Qt Mobility Service Framework module.

config BR2_PACKAGE_QT_MOBILITY_SENSORS
	bool "Sensors Module"
	help
	  Build the Qt Mobility Sensors module.

config BR2_PACKAGE_QT_MOBILITY_VERSIT
	bool "Versit Module"
	help
	  Build the Qt Mobility Versit module.

config BR2_PACKAGE_QT_MOBILITY_ORGANIZER
	bool "Organizer Module"
	help
	  Build the Qt Mobility Organizer module.

config BR2_PACKAGE_QT_MOBILITY_FEEDBACK
	bool "Feedback Module"
	help
	  Build the Qt Mobility Feedback module.

config BR2_PACKAGE_QT_MOBILITY_CONNECTIVITY
	bool "Connectivity Module"
	help
	  Build the Qt Mobility Connectivity module.

endif # BR2_PACKAGE_QT_MOBILITY
```

## package/v4l2test/Config.in
```kconfig
config BR2_PACKAGE_V4L2TEST
	depends on BR2_LINUX_KERNEL
	select BR2_PACKAGE_QT
	select BR2_PACKAGE_LIBQXT
	select BR2_PACKAGE_TI_FRAMEWORK_COMPONENTS
	select BR2_PACKAGE_TI_CODEC_ENGINE
	select BR2_PACKAGE_TI_XDCTOOLS
	select BR2_PACKAGE_TI_DM365_CODECS_H264ENC
	bool "V4L2Test Application"
	help
	  Build the v4l2test application
```
